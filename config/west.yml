## config/west.yml
```yaml
manifest:
  remotes:
    - name: glove80-zmk
      url-base: https://github.com/moergo-sc
  projects:
    - name: zmk
      remote: glove80-zmk
      revision: main
      import: app/west.yml
  self:
    path: config
```
